## Kconfig
```kconfig
menuconfig ZMK_ZEROSHIFT
    bool "ZeroShift persistent module selection"
    depends on SETTINGS
    help
      Store slot selections and activate them at startup using callbacks
      supplied by the keyboard configuration.

if ZMK_ZEROSHIFT

config ZMK_ZEROSHIFT_STUDIO
    bool "Expose keyboard-defined slots to ZeroShift Studio UI"
    depends on ZMK_STUDIO_RPC

config ZMK_ZEROSHIFT_SLOT_COUNT
    int "Number of local slots"
    range 1 255
    default 1

config ZMK_ZEROSHIFT_SETTINGS_SUBTREE
    string "Settings subtree"
    default "zeroshift"

config ZMK_ZEROSHIFT_SETTINGS_KEY
    string "Profile key within the subtree"
    default "profile-v1"

endif
```

## boards/shields/cagime_aaa/Kconfig.defconfig
```kconfig
if SHIELD_CAGIME_AAA_LEFT || SHIELD_CAGIME_AAA_RIGHT

config ZMK_SPLIT
    default y

config ZMK_KEYBOARD_NAME
    default "CaGiMe"

if SHIELD_CAGIME_AAA_LEFT

config ZMK_SPLIT_ROLE_CENTRAL
    default y

config ZMK_SPLIT_BLE_CENTRAL_PERIPHERALS
    default 1

endif
endif

if SHIELD_CAGIME_AAA_RIGHT || SHIELD_CAGIME_AAA_LEFT_J5

config ADC_ADS1220
    default y

config INPUT_ANALOG_AXIS_HIRES_SETTINGS
    default n

config INPUT_ANALOG_AXIS_HIRES_THREAD_STACK_SIZE
    default 2048

config INPUT_ANALOG_AXIS_HIRES_THREAD_PRIORITY
    default 9

config PM_DEVICE
    default y

endif
```

## boards/shields/cagime_aaa/Kconfig.shield
```kconfig
config SHIELD_CAGIME_AAA_LEFT
    def_bool $(shields_list_contains,cagime_aaa_left)

config SHIELD_CAGIME_AAA_RIGHT
    def_bool $(shields_list_contains,cagime_aaa_right)

config SHIELD_CAGIME_AAA_LEFT_J5
    def_bool $(shields_list_contains,cagime_aaa_left_j5)
```

## config/west.yml
```yaml
manifest:
  projects:
    - name: zmk
      url: https://github.com/cormoran/zmk
      revision: e5c9b6915b56801193e359dd9bad4a167ce0d1b8
      import: app/west.yml
    - name: zmk-layout-shift
      url: https://github.com/kot149/zmk-layout-shift
      revision: 4d71f7cb743256ac619873dd44f510e9e9562739
    - name: zmk-driver-pmw3610-with-custom-studio-rpc
      url: https://github.com/cormoran/zmk-driver-pmw3610-with-custom-studio-rpc
      revision: 5c34ea0eec246a1c986111417cd779b53144629a
    - name: zmk-driver-spi-three-wire
      url: https://github.com/te9no/zmk-driver-spi-three-wire
      revision: 4362133dbfbf66788b66b0a3e3c410b9232c06cb
    - name: ads1220-zephyr-module
      url: https://github.com/te9no/ads1220-zephyr-module
      revision: d618d1f3f198fd7e4ca3469da1683644be2d1b9f
  self:
    path: config
```

## dts/bindings/behaviors/cagime,behavior-led-test.yaml
```yaml
description: Momentary one-color LED test for CaGiMe AAA r01
compatible: "cagime,behavior-led-test"
include: one_param.yaml

properties:
  power-gpios:
    type: phandle-array
    required: true
  strip:
    type: phandle
    required: true
  max-channel-value:
    type: int
    required: true
    description: Upper bound for the eight-bit red channel sent to each pixel.
```

## dts/bindings/input/cagime,analog-stick.yaml
```yaml
# SPDX-License-Identifier: MIT

description: CaGiMe lower FPC analog stick
compatible: "cagime,analog-stick"
include: base.yaml

properties:
  io-channels:
    type: phandle-array
    required: true
    description: ADC channels, in X then Y order and ascending channel number
```

## dts/bindings/sensor/cagime,deferred-ec11.yaml
```yaml
# SPDX-License-Identifier: MIT

description: EC11 encoder on a CaGiMe FPC slot initialized from the saved module selection
compatible: "cagime,deferred-ec11"

include:
  - name: alps,ec11.yaml
  - name: base.yaml
    property-allowlist:
      - zephyr,deferred-init
```

## examples/one-slot/boards/shields/zeroshift_demo/Kconfig.defconfig
```kconfig
if SHIELD_ZEROSHIFT_DEMO

config ZMK_KEYBOARD_NAME
    default "ZeroShift Demo"

endif
```

## examples/one-slot/boards/shields/zeroshift_demo/Kconfig.shield
```kconfig
config SHIELD_ZEROSHIFT_DEMO
    def_bool $(shields_list_contains,zeroshift_demo)
```

## examples/one-slot/config/west.yml
```yaml
manifest:
  projects:
    - name: zmk
      url: https://github.com/cormoran/zmk
      revision: e5c9b6915b56801193e359dd9bad4a167ce0d1b8
      import: app/west.yml
    - name: zmk-feature-zeroshift
      url: https://github.com/te9no/zmk-feature-zeroshift
      revision: 7f638ffd91067af6f84e3026f50563f428cb1952
  self:
    path: config
```

## examples/one-slot/dts/bindings/behaviors/zeroshift-demo,save-mode.yaml
```yaml
description: Save the demo slot's requested mode
compatible: "zeroshift-demo,save-mode"
include: one_param.yaml
```
